## CMakeLists.txt
```
#
# Copyright (c) 2025 Nordic Semiconductor ASA
#
# SPDX-License-Identifier: LicenseRef-Nordic-5-Clause
#

cmake_minimum_required(VERSION 3.20.0)
find_package(Zephyr REQUIRED HINTS $ENV{ZEPHYR_BASE})
project(mcuboot_enc_dfu)

if(NOT (DEFINED SYSBUILD))
  message(FATAL_ERROR "This must be built with sysbuild.")
endif()

if(NOT CONFIG_MCUBOOT_BOOTLOADER_MODE_FIRMWARE_UPDATER)
  message(FATAL_ERROR "Invalid MCUboot mode selected.")
endif()

target_sources(app PRIVATE src/main.c)
#target_sources(app PRIVATE src/pad.c)
```

## sample.yaml
```
sample:
  description: MCUboot buttonless entry Bluetooth LE, for firmware loader mode, with encrypted image DFU
  name: MCUboot buttonless entry Bluetooth LE, encrypted image
tests:
  sample.boot.mcuboot_enc_dfu:
    sysbuild: true
    build_only: true
    integration_platforms:
      - bm_nrf54l15dk/nrf54l05/cpuapp/s145_softdevice/mcuboot
      - bm_nrf54lm20dk/nrf54lm20a/cpuapp/s145_softdevice/mcuboot
      - bm_nrf54ls05dk/nrf54ls05b/cpuapp/s145_softdevice/mcuboot
    platform_allow:
      - bm_nrf54l15dk/nrf54l05/cpuapp/s115_softdevice/mcuboot
      - bm_nrf54l15dk/nrf54l05/cpuapp/s145_softdevice/mcuboot
      - bm_nrf54l15dk/nrf54l10/cpuapp/s115_softdevice/mcuboot
      - bm_nrf54l15dk/nrf54l10/cpuapp/s145_softdevice/mcuboot
      - bm_nrf54l15dk/nrf54l15/cpuapp/s115_softdevice/mcuboot
      - bm_nrf54l15dk/nrf54l15/cpuapp/s145_softdevice/mcuboot
      - bm_nrf54lm20dk/nrf54lm20a/cpuapp/s115_softdevice/mcuboot
      - bm_nrf54lm20dk/nrf54lm20a/cpuapp/s145_softdevice/mcuboot
      - bm_nrf54ls05dk/nrf54ls05b/cpuapp/s115_softdevice/mcuboot
      - bm_nrf54ls05dk/nrf54ls05b/cpuapp/s145_softdevice/mcuboot
      - bm_nrf54lv10dk/nrf54lv10a/cpuapp/s115_softdevice/mcuboot
      - bm_nrf54lv10dk/nrf54lv10a/cpuapp/s145_softdevice/mcuboot
    tags:
      - sysbuild
```

## sysbuild.conf
```
SB_CONFIG_BM_BOOTLOADER_MCUBOOT_FIRMWARE_LOADER_ENTRANCE_BOOT_MODE=y
SB_CONFIG_BM_APP_CAN_SETUP_FIRMWARE_LOADER_NAME=y

# Firmware loader image decryption, the device private key goes to the end of the boot partition
SB_CONFIG_BM_FIRMWARE_LOADER_IMAGE_DECRYPTION=y
SB_CONFIG_BM_FIRMWARE_LOADER_ENC_KEY_FILE="enc-x25519-priv.pem"

# BOOTCONF write lock, not available for the nRF54LM20 in NCS BM v2.0.1
SB_CONFIG_BM_BOOT_BOOTCONF_LOCK_WRITES=y

# Nordic AP Protect
SB_CONFIG_APPROTECT_LOCK=y
SB_CONFIG_SECURE_APPROTECT_LOCK=y
```

## prj.conf
```kconfig
# Logging
CONFIG_LOG=y
CONFIG_LOG_MODE_MINIMAL=y

# Memory retention
CONFIG_RETAINED_MEM=y
CONFIG_RETENTION=y
CONFIG_RETENTION_BOOT_MODE=y
CONFIG_REBOOT=y

# MCUboot's imgtool parameters: app version and encryption key
CONFIG_MCUBOOT_IMGTOOL_SIGN_VERSION="1.0.0+0"
# imgtool can derive the public key from the private key, but only the public key is needed here
CONFIG_MCUBOOT_ENCRYPTION_KEY_FILE="./enc-x25519-pub.pem"

# SoftDevice
CONFIG_SOFTDEVICE=y

CONFIG_NRF_SDH_BLE_VS_UUID_COUNT=2
CONFIG_NRF_SDH_BLE_GAP_EVENT_LENGTH=10
CONFIG_NRF_SDH_BLE_GATT_MAX_MTU_SIZE=498

# Enable RNG
CONFIG_NRF_SECURITY=y
CONFIG_MBEDTLS_PSA_CRYPTO_C=y
CONFIG_PSA_WANT_GENERATE_RANDOM=y

# Advertising library
CONFIG_BLE_ADV=y

# BLE connection parameter
CONFIG_BLE_CONN_PARAMS=y
CONFIG_BLE_CONN_PARAMS_MAX_CONN_INTERVAL=24
CONFIG_BLE_CONN_PARAMS_SUP_TIMEOUT=20
CONFIG_BLE_CONN_PARAMS_MAX_SUP_TIMEOUT_DEVIATION=20
CONFIG_BLE_CONN_PARAMS_INITIATE_ATT_MTU_EXCHANGE=n
CONFIG_BLE_CONN_PARAMS_DATA_LENGTH_RX=251
CONFIG_BLE_CONN_PARAMS_DATA_LENGTH_TX=251

# MCUmgr
CONFIG_BLE_MCUMGR=y
CONFIG_MCUBOOT_BOOTUTIL_LIB=y
CONFIG_ZCBOR=y
CONFIG_NET_BUF=y
CONFIG_ZEPHYR_QUEUE=y
CONFIG_NCS_BM_MCUMGR=y
CONFIG_MCUMGR_TRANSPORT_REASSEMBLY=y
CONFIG_MCUMGR_MGMT_NOTIFICATION_HOOKS=y
CONFIG_MCUMGR_GRP_OS=y
CONFIG_MCUMGR_GRP_OS_RESET_HOOK=y
CONFIG_MCUMGR_GRP_OS_ECHO=y
CONFIG_MCUMGR_GRP_OS_MCUMGR_PARAMS=y
CONFIG_MCUMGR_GRP_OS_BOOTLOADER_INFO=y
CONFIG_MCUMGR_GRP_OS_RESET_BOOT_MODE=y
CONFIG_MCUMGR_GRP_SETTINGS=y
```

## boards/bm_nrf54l15dk_nrf54l15_cpuapp_s145_softdevice_mcuboot.overlay
```dts
/* slot1 (firmware loader) grows to 72 KB, slot0 shrinks to keep the SoftDevice at 0x15a000 */

&slot0_partition {
	reg = <0x0000a000 DT_SIZE_K(1272)>;
};

&slot1_partition {
	reg = <0x00148000 DT_SIZE_K(72)>;
};
```

## boards/bm_nrf54lm20dk_nrf54lm20a_cpuapp_s145_softdevice_mcuboot.overlay
```dts
/* slot1 (firmware loader) grows to 72 KB, slot0 shrinks to keep the SoftDevice at 0x1da000 */

&slot0_partition {
	reg = <0x0000a000 DT_SIZE_K(1784)>;
};

&slot1_partition {
	reg = <0x001c8000 DT_SIZE_K(72)>;
};
```

## src/pad.c
```c
/*
 * Padding for the image decryption timing test: fills slot0 up to the reserve below.
 * Not needed for normal use, remove src/pad.c from CMakeLists.txt to disable it.
 */

#include <stdint.h>
#include <zephyr/devicetree.h>
#include <zephyr/toolchain.h>

#define SLOT0_SIZE DT_REG_SIZE(DT_NODELABEL(slot0_partition))

/* Application code (~41 KB at the time of writing), image header and TLVs, plus a small margin. */
#define PAD_RESERVE (44 * 1024)

#define PAD_SIZE (SLOT0_SIZE - PAD_RESERVE)

BUILD_ASSERT(PAD_SIZE % 16 == 0, "The image payload must be a multiple of the AES block size");

/* retain: nothing references the array, so --gc-sections would drop it otherwise. */
static const uint8_t pad_blob[PAD_SIZE] __used __attribute__((retain)) __aligned(16) = {1};
```
